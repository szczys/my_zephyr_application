## west.yml
```yaml
manifest:
  version: 0.8

  projects:
    - name: golioth
      path: modules/lib/golioth
      revision: ff8de0da412680d8c8e3ca082369fda2f71a99ad
      url: https://github.com/golioth/golioth-zephyr-sdk.git
      import:
        file: west-zephyr.yml
        path-prefix: deps
        name-allowlist:
          - cmsis
          - hal_nordic
          - nrfxlib
          - mcuboot
          - qcbor
          - zephyr

  self:
    path: app
```
